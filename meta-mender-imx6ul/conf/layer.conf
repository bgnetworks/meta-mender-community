## meta-mender-imx6ul/conf/layer.conf
```bitbake
# We have a conf and classes directory, add to BBPATH
BBPATH .= ":${LAYERDIR}"

# We have recipes-* directories, add to BBFILES
BBFILES += "${LAYERDIR}/recipes-*/*/*.bb \
            ${LAYERDIR}/recipes-*/*/*.bbappend"

BBFILE_COLLECTIONS += "meta-mender-imx6ul"
BBFILE_PATTERN_meta-mender-imx6ul = "^${LAYERDIR}/"
BBFILE_PRIORITY_meta-mender-imx6ul = "6"

LAYERDEPENDS_meta-mender-imx6ul = "core"
LAYERSERIES_COMPAT_meta-mender-imx6ul = "warrior"
```
